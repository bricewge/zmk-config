## config/west.yml
```yaml
manifest:
  remotes:
    - name: zmkfirmware
      url-base: https://github.com/zmkfirmware
    - name: megamind4089
      url-base: https://github.com/megamind4089
    - name: bricewge
      url-base: https://github.com/bricewge
  projects:
    - name: zmk
      remote: zmkfirmware
      revision: main
      import: app/west.yml
    # - name: zmk
    #   remote: bricewge
    #   revision: m60
    #   import: app/west.yml
  self:
    path: config
```
